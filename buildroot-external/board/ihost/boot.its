## buildroot-external/board/ihost/boot.its
```
/*
 * Copyright (C) 2020 Rockchip Electronics Co., Ltd
 *
 * SPDX-License-Identifier: GPL-2.0
 */

/dts-v1/;
/ {
    description = "U-Boot FIT source file for arm";

    images {
        fdt {
            data = /incbin/("@KERNEL_DTB@");
            type = "flat_dt";
            arch = "arm";
            compression = "none";
            load = <0x08300000>;

            hash {
                algo = "sha256";
            };
        };

        kernel {
            data = /incbin/("@KERNEL_IMG@");
            type = "kernel";
            arch = "arm";
            os = "linux";
            compression = "none";
            entry = <0x02008000>;
            load = <0x02008000>;

            hash {
                algo = "sha256";
            };
        };

    };

    configurations {
        default = "conf";

        conf {
            rollback-index = <0x00>;
            fdt = "fdt";
            kernel = "kernel";

            signature {
                algo = "sha256,rsa2048";
                padding = "pss";
                key-name-hint = "dev";
                sign-images = "fdt", "kernel";
            };
        };
    };
};
```

## buildroot-external/configs/linux_distro_defconfig
```kconfig
BR2_arm=y
BR2_cortex_a7=y
BR2_ARM_FPU_NEON_VFPV4=y
BR2_PACKAGE_HOST_LINUX_HEADERS_CUSTOM_6_1=y
BR2_PACKAGE_OVERRIDE_FILE="$(BR2_EXTERNAL_LINUX_DISTRO_PATH)/local.mk"
BR2_INIT_SYSTEMD=y
BR2_TARGET_GENERIC_ROOT_PASSWD="root"
BR2_SYSTEM_DEFAULT_PATH="/bin:/sbin:/usr/bin:/usr/sbin"
BR2_ROOTFS_POST_BUILD_SCRIPT="$(BR2_EXTERNAL_LINUX_DISTRO_PATH)/board/linux_distro/post-build.sh"
BR2_ROOTFS_POST_IMAGE_SCRIPT="$(BR2_EXTERNAL_LINUX_DISTRO_PATH)/board/linux_distro/post-image.sh"
BR2_LINUX_KERNEL=y
BR2_LINUX_KERNEL_CUSTOM_GIT=y
BR2_LINUX_KERNEL_CUSTOM_REPO_URL="https://github.com/Mrz-creator/linux-rockchip.git"
BR2_LINUX_KERNEL_CUSTOM_REPO_VERSION="feature_ihost"
BR2_LINUX_KERNEL_USE_CUSTOM_CONFIG=y
BR2_LINUX_KERNEL_CUSTOM_CONFIG_FILE="$(BR2_EXTERNAL_LINUX_DISTRO_PATH)/board/linux_distro/rv1126_defconfig.config"
BR2_LINUX_KERNEL_CONFIG_FRAGMENT_FILES="$(BR2_EXTERNAL_LINUX_DISTRO_PATH)/kernel/ihostconfig/rv1126-debugger.config $(BR2_EXTERNAL_LINUX_DISTRO_PATH)/kernel/ihostconfig/rv1126-docker.config $(BR2_EXTERNAL_LINUX_DISTRO_PATH)/kernel/ihostconfig/rv1126-ipset.config $(BR2_EXTERNAL_LINUX_DISTRO_PATH)/kernel/ihostconfig/rv1126-ipv6.config $(BR2_EXTERNAL_LINUX_DISTRO_PATH)/kernel/ihostconfig/rv1126-network.config"
BR2_LINUX_KERNEL_LZ4=y
BR2_LINUX_KERNEL_DTS_SUPPORT=y
BR2_LINUX_KERNEL_INTREE_DTS_NAME="rv1126-ihost"
BR2_LINUX_KERNEL_NEEDS_HOST_OPENSSL=y
BR2_LINUX_KERNEL_NEEDS_HOST_LIBELF=y
BR2_PACKAGE_ROCKCHIP_RKBIN=y
BR2_PACKAGE_DROPBEAR=y
BR2_PACKAGE_NETWORK_MANAGER=y
BR2_PACKAGE_NETWORK_MANAGER_CLI=y
BR2_TARGET_ROOTFS_EXT2=y
BR2_TARGET_ROOTFS_EXT2_SIZE="128M"
BR2_TARGET_ROOTFS_SQUASHFS=y
```
